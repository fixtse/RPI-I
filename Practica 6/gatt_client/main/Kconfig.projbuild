## Practica 6/gatt_client/main/Kconfig.projbuild
```kconfig
menu "Example Configuration"

    config EXAMPLE_DUMP_ADV_DATA_AND_SCAN_RESP
        bool "Dump whole adv data and scan response data in example"
        default n

    config EXAMPLE_CI_ID
        int "example id for CI test"
        default 0
        help
            This config the example id for CI test. Only for internal used.

    config EXAMPLE_CI_PIPELINE_ID
        int "The pipeline id for CI test"
        default 0
        help
            This config the pipeline id for CI test. Only for internal used.

    config EXAMPLE_INIT_DEINIT_LOOP
        bool "Perform init deinit of bluedroid host in a loop"
        default n
        help
            This config perform host init deinit loop for CI test. Only for internal used

    config BLE_SCAN_INTERVAL_MS
        int "Intervalo de escaneo (ms)"
        range 5 10240
        default 100
        help
            Tiempo entre el inicio de dos intervalos de escaneo.

    config BLE_SCAN_WINDOW_MS
        int "Ventana de escaneo (ms)"
        range 5 10240
        default 20
        help
            Tiempo durante el cual el ESP32 escucha dispositivos BLE.  
            
   config BLE_SCAN_INTERVAL_MS
        int "Intervalo de escaneo (ms)"
        range 5 10240
        default 100
        help
            Tiempo entre el inicio de dos intervalos de escaneo.

    config BLE_SCAN_WINDOW_MS
        int "Ventana de escaneo (ms)"
        range 5 10240
        default 20
        help
            Tiempo durante el cual el ESP32 escucha dispositivos BLE.
            

endmenu
```
